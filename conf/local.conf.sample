## conf/local.conf.sample
```bitbake
CONF_VERSION = "1"
DL_DIR = "${TOPDIR}/downloads"

MACHINE = "intel-corei7-64"
SDKMACHINE = "x86_64"
DISTRO = "pelux"

BB_NUMBER_THREADS ?= "${@oe.utils.cpu_count()}"
PARALLEL_MAKE ?= "-j ${@oe.utils.cpu_count()}"

PACKAGE_CLASSES ?= "package_rpm"
EXTRA_IMAGE_FEATURES_append = " debug-tweaks "

DISTRO_FEATURES_append = " opengl "

BB_DANGLINGAPPENDS_WARNONLY = "1"

# For GStreamer etc
LICENSE_FLAGS_WHITELIST = "commercial license"
```
